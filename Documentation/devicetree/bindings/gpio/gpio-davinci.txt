## Documentation/devicetree/bindings/gpio/gpio-davinci.txt
```
Davinci GPIO controller bindings

Required Properties:
- compatible:"ti,da830-gpio"

- reg: Physical base address of the controller and length of memory mapped
	region.

- interrupts: Array of GPIO interrupt number.

- ngpio: The number of GPIO pins supported

- intc_irq_num: The number of IRQs supported by the Interrupt Controller

- gpio_unbanked: The number of GPIOs that have an individual interrupt
		line to processor.

Example:
#include <dt-bindings/interrupt-controller/irq.h>

gpio: gpio@1e26000 {
	compatible = "ti,da830-gpio";
	reg = <0x226000 0x1000>;
	interrupts = <42 IRQ_TYPE_EDGE_BOTH 43 IRQ_TYPE_EDGE_BOTH
		44 IRQ_TYPE_EDGE_BOTH 45 IRQ_TYPE_EDGE_BOTH
		46 IRQ_TYPE_EDGE_BOTH 47 IRQ_TYPE_EDGE_BOTH
		48 IRQ_TYPE_EDGE_BOTH 49 IRQ_TYPE_EDGE_BOTH
		50 IRQ_TYPE_EDGE_BOTH>;
	ngpio = <144>;
	intc_irq_num = <101>;
	gpio_unbanked = <0>;
};
```

## Documentation/devicetree/bindings/pwm/pwm_test.txt
```
pwm-test bindings

Required properties:
  - compatible: "pwm-test"
  - pwms: OF device-tree PWM specification (see PWM binding[0])

Optional properties:
  - pwm-names: a list of names for the PWM devices specified in the
               "pwms" property (see PWM binding[0])

[0]: Documentation/devicetree/bindings/pwm/pwm.txt

Example:

	pwm_test: pwm_test{
		compatible = "pwm_test";
		pwms = <&pwm 0 5000000 0>;
		pwm-names = "pwm";
	};
```
